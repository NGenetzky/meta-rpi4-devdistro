## conf/distro/rpi4-devdistro-systemd.conf
```bitbake
require conf/distro/poky.conf

DISTRO = "rpi4-devdistro-systemd"
DISTRO_NAME = "RPI4 Development Distro"
DISTRO_VERSION = "1"
HOSTNAME ?= "rpi4-devdistro"

# Systemd-ize
DISTRO_FEATURES_append = " systemd"
VIRTUAL-RUNTIME_init_manager = "systemd"
DISTRO_FEATURES_BACKFILL_CONSIDERED = "sysvinit"
DISTRO_FEATURES_append = " virtualization"

# Strip down unneeded features
POKY_DEFAULT_DISTRO_FEATURES_remove = "ptest"
POKY_DEFAULT_DISTRO_FEATURES_remove = "wayland"
POKY_DEFAULT_DISTRO_FEATURES_remove = "opengl"
POKY_DEFAULT_DISTRO_FEATURES_remove = "vulkan"
DISTRO_FEATURES_DEFAULT_remove = "x11"
DISTRO_FEATURES_DEFAULT_remove = "alsa"
DISTRO_FEATURES_BACKFILL_remove = "pulseaudio"

PREFERRED_PROVIDER_virtual/docker = "docker-moby"
```

## conf/layer.conf
```bitbake
BBPATH .= ":${LAYERDIR}"
BBFILES += "${LAYERDIR}/recipes-*/*/*.bb ${LAYERDIR}/recipes-*/*/*.bbappend"

BBFILE_COLLECTIONS += "rpi4-devdistro-layer"
BBFILE_PATTERN_rpi4-devdistro-layer := "^${LAYERDIR}/"
BBFILE_PRIORITY_rpi4-devdistro-layer = "10"

LAYERVERSION_rpi4-devdistro-layer = "1"
LAYERDEPENDS_rpi4-devdistro-layer = "virtualization-layer"
LAYERSERIES_COMPAT_rpi4-devdistro-layer = "warrior zeus"

DISTRO ?= "rpi4-devdistro-systemd"
MACHINE = "raspberrypi4-64"
```
